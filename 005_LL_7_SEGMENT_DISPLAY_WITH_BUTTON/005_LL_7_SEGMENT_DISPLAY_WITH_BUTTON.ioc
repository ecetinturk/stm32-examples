# file: 005_LL_7_SEGMENT_DISPLAY_WITH_BUTTON.ioc
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Mcu.Family=STM32F4
Mcu.Name=STM32F407V(E-G)Tx
Mcu.Package=LQFP100
NVIC.PriorityGroup=NVIC_PRIORITYGROUP_0
ProjectManager.HeapSize=0x200
ProjectManager.StackSize=0x400
ProjectManager.TargetToolchain=STM32CubeIDE
RCC.48MHZClocksFreq_Value=48000000
RCC.AHBFreq_Value=168000000
RCC.APB1CLKDivider=RCC_HCLK_DIV4
RCC.APB1Freq_Value=42000000
RCC.APB1TimFreq_Value=84000000
RCC.APB2CLKDivider=RCC_HCLK_DIV2
RCC.APB2Freq_Value=84000000
RCC.APB2TimFreq_Value=168000000
RCC.CortexFreq_Value=168000000
RCC.HCLKFreq_Value=168000000
RCC.HSE_VALUE=8000000
RCC.HSI_VALUE=16000000
RCC.PLLM=8
RCC.PLLN=168
RCC.PLLQ=7
RCC.SYSCLKFreq_VALUE=168000000
RCC.SYSCLKSource=RCC_SYSCLKSOURCE_PLLCLK
RCC.VCOOutputFreq_Value=336000000
board=STM32F407G-DISC1

// file: Core/Src/main.c
/* USER CODE BEGIN Header */
/**
  ******************************************************************************
  * @file           : main.c
  * @brief          : Main program body
  ******************************************************************************
  * @attention
  *
  * Copyright (c) 2023 STMicroelectronics.
  * All rights reserved.
  *
  * This software is licensed under terms that can be found in the LICENSE file
  * in the root directory of this software component.
  * If no LICENSE file comes with this software, it is provided AS-IS.
  *
  ******************************************************************************
  */
/* USER CODE END Header */
#include "main.h"

/* USER CODE BEGIN Includes */
#include "stm32f4xx.h"
#include "stm32f407xx.h"
#include "stm32f4xx_ll_bus.h"
#include "stm32f4xx_ll_rcc.h"
#include "stm32f4xx_ll_gpio.h"
/* USER CODE END Includes */

/* USER CODE BEGIN PTD */
GPIO_InitTypeDef GPIO_InitStruct;
/* USER CODE END PTD */

/* USER CODE BEGIN PV */
int count = 0;
/* USER CODE END PV */

void SystemClock_Config(void);
/* USER CODE BEGIN PFP */
void GPIO_Config(void);
void Delay(uint32_t time);
/* USER CODE END PFP */

/* USER CODE BEGIN 0 */
void GPIO_Config()
{
	LL_AHB1_GRP1_EnableClock(LL_AHB1_GRP1_PERIPH_GPIOA);
	LL_AHB1_GRP1_EnableClock(LL_AHB1_GRP1_PERIPH_GPIOE);

	GPIO_InitStruct.Pin = LL_GPIO_PIN_0;
	GPIO_InitStruct.Mode = LL_GPIO_MODE_INPUT;
	GPIO_InitStruct.Alternate = LL_GPIO_OUTPUT_PUSHPULL;
	GPIO_InitStruct.Pull = LL_GPIO_PULL_DOWN;
	GPIO_InitStruct.Speed = LL_GPIO_SPEED_FREQ_VERY_HIGH;

	HAL_GPIO_Init(GPIOE, &GPIO_InitStruct);

	GPIO_InitStruct.Pin = LL_GPIO_PIN_0 |
							LL_GPIO_PIN_1 |
							LL_GPIO_PIN_2 |
							LL_GPIO_PIN_3 |
							LL_GPIO_PIN_4 |
							LL_GPIO_PIN_5 |
							LL_GPIO_PIN_6;
	GPIO_InitStruct.Mode = LL_GPIO_MODE_OUTPUT;
	GPIO_InitStruct.Alternate = LL_GPIO_OUTPUT_PUSHPULL;
	GPIO_InitStruct.Pull = LL_GPIO_PULL_NO;
	GPIO_InitStruct.Speed = LL_GPIO_SPEED_FREQ_VERY_HIGH;

	HAL_GPIO_Init(GPIOA, &GPIO_InitStruct);
}

void Delay(uint32_t time)
{
	while(time--);
}
/* USER CODE END 0 */

int main(void)
{

  /* MCU Configuration--------------------------------------------------------*/

  /* Reset of all peripherals, Initializes the Flash interface and the Systick. */
  HAL_Init();

  /* USER CODE BEGIN Init */
  GPIO_Config();
  /* USER CODE END Init */

  /* Configure the system clock */
  SystemClock_Config();

  /* Initialize all configured peripherals */

  /* Infinite loop */
  /* USER CODE BEGIN WHILE */
  while (1)
  {
	  if (LL_GPIO_ReadInputPort(GPIOE) & LL_GPIO_PIN_0)
	  {
		  while (LL_GPIO_ReadInputPort(GPIOE) & LL_GPIO_PIN_0);
		  Delay(168000);

		  count++;
	  }

  	  switch (count)
	  {
		  case 0:
		  {
			  LL_GPIO_SetOutputPin(GPIOA, LL_GPIO_PIN_0 |
									LL_GPIO_PIN_1 |
									LL_GPIO_PIN_2 |
									LL_GPIO_PIN_3 |
									LL_GPIO_PIN_4 |
									LL_GPIO_PIN_6);
			  LL_GPIO_ResetOutputPin(GPIOA, LL_GPIO_PIN_5);
			  break;
		  }
		  case 1:
		  {
			  LL_GPIO_SetOutputPin(GPIOA, LL_GPIO_PIN_1 |
									LL_GPIO_PIN_2);
			  LL_GPIO_ResetOutputPin(GPIOA, LL_GPIO_PIN_0 |
									LL_GPIO_PIN_3 |
									LL_GPIO_PIN_4 |
									LL_GPIO_PIN_5 |
									LL_GPIO_PIN_6);
			  break;
		  }
		  case 2:
		  {
			  LL_GPIO_SetOutputPin(GPIOA, LL_GPIO_PIN_0 |
									LL_GPIO_PIN_1 |
									LL_GPIO_PIN_3 |
									LL_GPIO_PIN_4 |
									LL_GPIO_PIN_5);
			  LL_GPIO_ResetOutputPin(GPIOA, LL_GPIO_PIN_2 |
									LL_GPIO_PIN_6);
			  break;
		  }
		  case 3:
		  {
			  LL_GPIO_SetOutputPin(GPIOA, LL_GPIO_PIN_0 |
									LL_GPIO_PIN_1 |
									LL_GPIO_PIN_2 |
									LL_GPIO_PIN_3 |
									LL_GPIO_PIN_5);
			  LL_GPIO_ResetOutputPin(GPIOA, LL_GPIO_PIN_4 |
									LL_GPIO_PIN_6);
			  break;
		  }
		  case 4:
		  {
			  LL_GPIO_SetOutputPin(GPIOA, LL_GPIO_PIN_1 |
									LL_GPIO_PIN_2 |
									LL_GPIO_PIN_5 |
									LL_GPIO_PIN_6);
			  LL_GPIO_ResetOutputPin(GPIOA, LL_GPIO_PIN_0 |
									LL_GPIO_PIN_3 |
									LL_GPIO_PIN_4);
			  break;
		  }
		  case 5:
		  {
			  LL_GPIO_SetOutputPin(GPIOA, LL_GPIO_PIN_0 |
									LL_GPIO_PIN_2 |
									LL_GPIO_PIN_3 |
									LL_GPIO_PIN_5 |
									LL_GPIO_PIN_6);
			  LL_GPIO_ResetOutputPin(GPIOA, LL_GPIO_PIN_1 |
									LL_GPIO_PIN_4);
			  break;
		  }
		  case 6:
		  {
			  LL_GPIO_SetOutputPin(GPIOA, LL_GPIO_PIN_0 |
									LL_GPIO_PIN_2 |
									LL_GPIO_PIN_3 |
									LL_GPIO_PIN_4 |
									LL_GPIO_PIN_5 |
									LL_GPIO_PIN_6);
			  LL_GPIO_ResetOutputPin(GPIOA, LL_GPIO_PIN_1);
			  break;
		  }
		  case 7:
		  {
			  LL_GPIO_SetOutputPin(GPIOA, LL_GPIO_PIN_0 |
									LL_GPIO_PIN_1 |
									LL_GPIO_PIN_2);
			  LL_GPIO_ResetOutputPin(GPIOA, LL_GPIO_PIN_3 |
									LL_GPIO_PIN_4 |
									LL_GPIO_PIN_5 |
									LL_GPIO_PIN_6);
			  break;
		  }
		  case 8:
		  {
			  LL_GPIO_SetOutputPin(GPIOA, LL_GPIO_PIN_ALL);
			  break;
		  }
		  case 9:
		  {
			  LL_GPIO_SetOutputPin(GPIOA, LL_GPIO_PIN_0 |
									LL_GPIO_PIN_1 |
									LL_GPIO_PIN_2 |
									LL_GPIO_PIN_5 |
									LL_GPIO_PIN_6);
			  LL_GPIO_ResetOutputPin(GPIOA, LL_GPIO_PIN_3 |
									LL_GPIO_PIN_4);
			  break;
		  }
		  default:
		  {
			  count = 0;
			  break;
		  }
	  }
    /* USER CODE END WHILE */

  }
}

void SystemClock_Config(void)
{
  RCC_OscInitTypeDef RCC_OscInitStruct = {0};
  RCC_ClkInitTypeDef RCC_ClkInitStruct = {0};

  /** Configure the main internal regulator output voltage
  */
  __HAL_RCC_PWR_CLK_ENABLE();
  __HAL_PWR_VOLTAGESCALING_CONFIG(PWR_REGULATOR_VOLTAGE_SCALE1);

  /** Initializes the RCC Oscillators according to the specified parameters
  * in the RCC_OscInitTypeDef structure.
  */
  RCC_OscInitStruct.OscillatorType = RCC_OSCILLATORTYPE_HSI;
  RCC_OscInitStruct.HSIState = RCC_HSI_ON;
  RCC_OscInitStruct.HSICalibrationValue = RCC_HSICALIBRATION_DEFAULT;
  RCC_OscInitStruct.PLL.PLLState = RCC_PLL_ON;
  RCC_OscInitStruct.PLL.PLLSource = RCC_PLLSOURCE_HSI;
  RCC_OscInitStruct.PLL.PLLM = 8;
  RCC_OscInitStruct.PLL.PLLN = 168;
  RCC_OscInitStruct.PLL.PLLP = RCC_PLLP_DIV2;
  RCC_OscInitStruct.PLL.PLLQ = 7;
  if (HAL_RCC_OscConfig(&RCC_OscInitStruct) != HAL_OK)
  {
    Error_Handler();
  }

  /** Initializes the CPU, AHB and APB buses clocks
  */
  RCC_ClkInitStruct.ClockType = RCC_CLOCKTYPE_HCLK|RCC_CLOCKTYPE_SYSCLK
                              |RCC_CLOCKTYPE_PCLK1|RCC_CLOCKTYPE_PCLK2;
  RCC_ClkInitStruct.SYSCLKSource = RCC_SYSCLKSOURCE_PLLCLK;
  RCC_ClkInitStruct.AHBCLKDivider = RCC_SYSCLK_DIV1;
  RCC_ClkInitStruct.APB1CLKDivider = RCC_HCLK_DIV4;
  RCC_ClkInitStruct.APB2CLKDivider = RCC_HCLK_DIV2;

  if (HAL_RCC_ClockConfig(&RCC_ClkInitStruct, FLASH_LATENCY_5) != HAL_OK)
  {
    Error_Handler();
  }
}

void Error_Handler(void)
{
  __disable_irq();
  while (1)
  {
  }
}
