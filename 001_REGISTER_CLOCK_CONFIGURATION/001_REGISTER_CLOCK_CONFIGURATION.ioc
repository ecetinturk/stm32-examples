# file: 001_REGISTER_CLOCK_CONFIGURATION.ioc
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Mcu.Family=STM32F4
Mcu.Name=STM32F407V(E-G)Tx
Mcu.Package=LQFP100
NVIC.PriorityGroup=NVIC_PRIORITYGROUP_0
ProjectManager.HeapSize=0x200
ProjectManager.StackSize=0x400
ProjectManager.TargetToolchain=STM32CubeIDE
RCC.48MHZClocksFreq_Value=48000000
RCC.AHBFreq_Value=168000000
RCC.APB1CLKDivider=RCC_HCLK_DIV4
RCC.APB1Freq_Value=42000000
RCC.APB1TimFreq_Value=84000000
RCC.APB2CLKDivider=RCC_HCLK_DIV2
RCC.APB2Freq_Value=84000000
RCC.APB2TimFreq_Value=168000000
RCC.CortexFreq_Value=168000000
RCC.HCLKFreq_Value=168000000
RCC.HSE_VALUE=8000000
RCC.HSI_VALUE=16000000
RCC.PLLM=8
RCC.PLLN=168
RCC.PLLQ=7
RCC.SYSCLKFreq_VALUE=168000000
RCC.SYSCLKSource=RCC_SYSCLKSOURCE_PLLCLK
RCC.VCOOutputFreq_Value=336000000
board=STM32F407G-DISC1

// file: Core/Src/main.c
/* USER CODE BEGIN Header */
/**
  ******************************************************************************
  * @file           : main.c
  * @brief          : Main program body
  ******************************************************************************
  * @attention
  *
  * Copyright (c) 2023 STMicroelectronics.
  * All rights reserved.
  *
  * This software is licensed under terms that can be found in the LICENSE file
  * in the root directory of this software component.
  * If no LICENSE file comes with this software, it is provided AS-IS.
  *
  ******************************************************************************
  */
/* USER CODE END Header */
#include "main.h"

/* USER CODE BEGIN Includes */
#include "stm32f4xx.h"
#include "stm32f407xx.h"

extern uint32_t SystemCoreClock;
/* USER CODE END Includes */

/* USER CODE BEGIN PV */
uint32_t systemClock;
/* USER CODE END PV */

void SystemClock_Config(void);
/* USER CODE BEGIN PFP */
void RCC_Config(void);
/* USER CODE END PFP */

/* USER CODE BEGIN 0 */
void RCC_Config(void)
{

	RCC->CR &= ~(1 << 0);				// HSI off
	// RCC->CR &= 0x00000083;

	RCC->CR |= 1 << 16;					// HSE on
	while(!(RCC->CR & (1 << 17)));		// Wait HSE active

	RCC->CR |= 1 << 19;					// CSS on

	RCC->PLLCFGR = 0x00000000;			// PLLCFGR reset

	RCC->PLLCFGR |= (1 << 22);			// PLL source HSE

	// RCC->PLLCFGR &= ~(31 << 0);

	RCC->PLLCFGR |= (4 << 0);			// PLL M = 4
	/*
	RCC->PLLCFGR &= ~(1 << 0);	// PLLM0 = 0
	RCC->PLLCFGR &= ~(1 << 1);	// PLLM1 = 0
	RCC->PLLCFGR &= (1 << 2);	// PLLM2 = 1
	RCC->PLLCFGR &= ~(1 << 3);	// PLLM3 = 0
	RCC->PLLCFGR &= ~(1 << 4);	// PLLM4 = 0
	*/

	// PLLN0 = 168 = 010101000
	RCC->PLLCFGR |= (168 << 6);			// PLL N = 168

	// PLLP0 = 0
	// PLLP1 = 0
	RCC->PLLCFGR &= ~(1 << 16);			// PLL P = 0
	RCC->PLLCFGR &= ~(1 << 17);

	RCC->CR |= (1 << 24);				// PLL on
	while(!(RCC->CR & (1 << 25)));		// Wait PLL active

	RCC->CFGR &= ~(1 << 0);
	RCC->CFGR |= (1 << 1);				// System clock is PLL

	while(!(RCC->CFGR & (1 << 1)));		// Select system clock is PLL clock

}
/* USER CODE END 0 */

int main(void)
{

  /* MCU Configuration--------------------------------------------------------*/

  /* Reset of all peripherals, Initializes the Flash interface and the Systick. */
  HAL_Init();

  /* Configure the system clock */
  SystemClock_Config();

  /* Initialize all configured peripherals */

  /* Infinite loop */
  /* USER CODE BEGIN WHILE */
  while (1)
  {
	  systemClock = SystemCoreClock;
	  HAL_RCC_DeInit();				// HSIEN PLL OFF
	  SystemCoreClockUpdate();
	  systemClock = SystemCoreClock;
	  RCC_Config();
	  SystemCoreClockUpdate();
	  systemClock = SystemCoreClock;
    /* USER CODE END WHILE */

  }
}

void SystemClock_Config(void)
{
  RCC_OscInitTypeDef RCC_OscInitStruct = {0};
  RCC_ClkInitTypeDef RCC_ClkInitStruct = {0};

  /** Configure the main internal regulator output voltage
  */
  __HAL_RCC_PWR_CLK_ENABLE();
  __HAL_PWR_VOLTAGESCALING_CONFIG(PWR_REGULATOR_VOLTAGE_SCALE1);

  /** Initializes the RCC Oscillators according to the specified parameters
  * in the RCC_OscInitTypeDef structure.
  */
  RCC_OscInitStruct.OscillatorType = RCC_OSCILLATORTYPE_HSI;
  RCC_OscInitStruct.HSIState = RCC_HSI_ON;
  RCC_OscInitStruct.HSICalibrationValue = RCC_HSICALIBRATION_DEFAULT;
  RCC_OscInitStruct.PLL.PLLState = RCC_PLL_ON;
  RCC_OscInitStruct.PLL.PLLSource = RCC_PLLSOURCE_HSI;
  RCC_OscInitStruct.PLL.PLLM = 8;
  RCC_OscInitStruct.PLL.PLLN = 168;
  RCC_OscInitStruct.PLL.PLLP = RCC_PLLP_DIV2;
  RCC_OscInitStruct.PLL.PLLQ = 7;
  if (HAL_RCC_OscConfig(&RCC_OscInitStruct) != HAL_OK)
  {
    Error_Handler();
  }

  /** Initializes the CPU, AHB and APB buses clocks
  */
  RCC_ClkInitStruct.ClockType = RCC_CLOCKTYPE_HCLK|RCC_CLOCKTYPE_SYSCLK
                              |RCC_CLOCKTYPE_PCLK1|RCC_CLOCKTYPE_PCLK2;
  RCC_ClkInitStruct.SYSCLKSource = RCC_SYSCLKSOURCE_PLLCLK;
  RCC_ClkInitStruct.AHBCLKDivider = RCC_SYSCLK_DIV1;
  RCC_ClkInitStruct.APB1CLKDivider = RCC_HCLK_DIV4;
  RCC_ClkInitStruct.APB2CLKDivider = RCC_HCLK_DIV2;

  if (HAL_RCC_ClockConfig(&RCC_ClkInitStruct, FLASH_LATENCY_5) != HAL_OK)
  {
    Error_Handler();
  }
}

void Error_Handler(void)
{
  __disable_irq();
  while (1)
  {
  }
}
